## common/labid/Kconfig
```kconfig
# LABID common library

menuconfig LABID
	bool "LABID serial identity protocol"
	default n
	help
	  Portable C99 implementation of the LABID serial identity frame
	  protocol (PLAN §7.3). No malloc, no RTOS calls, fixed buffers.
```

## esp_idf/main/Kconfig.projbuild
```kconfig
menu "bootlab-esp app config (BL-020)"

    choice APP_VARIANT
        prompt "Build variant (PLAN Sec 5.3)"
        default APP_VARIANT_V1
        help
            Selects which of the 5 build variants this image is. Each
            variant is a separate build (labflash build <board> --variant
            builds all 5, per BL-045).

        config APP_VARIANT_V1
            bool "v1 -- 1 Hz blink, confirms (factory image, downgrade tests)"
        config APP_VARIANT_V2
            bool "v2 -- 4 Hz blink, confirms (upgrade tests)"
        config APP_VARIANT_NO_CONFIRM
            bool "no_confirm -- blinks, never confirms (rollback tests)"
        config APP_VARIANT_HANG
            bool "hang -- blocks all tasks after boot, watchdog reset within 10s"
        config APP_VARIANT_BAD_SIG
            bool "bad_sig -- signed with the wrong key (security tests)"
    endchoice

    config APP_LED_GPIO
        int "LED strip (WS2812) GPIO"
        default 48
        help
            CONFIRMED 48 via physical power-cycle test on 2026-09-20 --
            GPIO38 was tried based on a false signal (R14's reset-into-
            bootloader made a single latched WS2812 frame look like "wrong
            pin, steady light"; a true physical power-cycle (unplug/replug,
            not a USB/software reset) confirmed 48 was correct all along --
            lab-esp-idf blinked white at 1Hz, counted and confirmed by the
            owner). See host/config/rig.yaml and PLAN Sec 9 R14. Do not
            revisit this pin without re-testing via a real physical
            power-cycle, not a USB reset (esptool/idf_monitor resets are
            unreliable on this host, see R14).

endmenu
```
